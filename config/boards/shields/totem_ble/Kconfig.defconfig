## config/boards/shields/totem_ble/Kconfig.defconfig
```kconfig
# Copyright (c) 2025 The ZMK Contributors
# SPDX-License-Identifier: MIT

if SHIELD_TOTEM_BLE_LEFT

config ZMK_KEYBOARD_NAME
    default "Totem"

config ZMK_SPLIT_ROLE_CENTRAL
    default y

endif

if SHIELD_TOTEM_BLE_LEFT || SHIELD_TOTEM_BLE_RIGHT

config ZMK_SPLIT
    default y

config ZMK_BLE
    default y

endif
```

## config/boards/shields/totem_ble/Kconfig.shield
```kconfig
# Copyright (c) 2023 The ZMK Contributors
# SPDX-License-Identifier: MIT

config SHIELD_TOTEM_BLE_LEFT
	def_bool $(shields_list_contains,totem_ble_left)

config SHIELD_TOTEM_BLE_RIGHT
	def_bool $(shields_list_contains,totem_ble_right)
```
