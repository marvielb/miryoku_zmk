## config/boards/shields/cygnus/Kconfig.defconfig
```kconfig
# Copyright 2022 Manna Harbour
# https://github.com/manna-harbour/miryoku

if SHIELD_CYGNUS_LEFT || SHIELD_CYGNUS_RIGHT || SHIELD_CYGNUS_DONGLE

config ZMK_KEYBOARD_NAME
	default "Cygnus"

config ZMK_SPLIT
	default y

config ZMK_BLE
	default y

endif

if SHIELD_CYGNUS_DONGLE

config ZMK_SPLIT_ROLE_CENTRAL
	default y

config ZMK_USB
	default y

config ZMK_SPLIT_BLE_CENTRAL_PERIPHERALS
	default 2

config ZMK_SLEEP
	default n

endif
```
